## sdkconfig.defaults
```kconfig
#
# Serial flasher config
#
CONFIG_ESPTOOLPY_MONITOR_BAUD_115200B=y
CONFIG_ESPTOOLPY_FLASHSIZE_4MB=y

#
# Bootloader config
#
CONFIG_BOOTLOADER_LOG_LEVEL_NONE=y

#
# Partition Table
#
CONFIG_PARTITION_TABLE_CUSTOM=y
CONFIG_PARTITION_TABLE_FILENAME="partitions.csv"

#
# Compiler options
#
CONFIG_OPTIMIZATION_LEVEL_RELEASE=y

#
# Bluetooth
#
CONFIG_BT_ENABLED=n

#
# Bluetooth Controller
#
CONFIG_BTDM_CTRL_MODE_BTDM=n
CONFIG_BTDM_CTRL_BLE_MAX_CONN_EFF=3

#
# Bluedroid Options
#
CONFIG_BT_BTC_TASK_STACK_SIZE=4096
CONFIG_BT_CLASSIC_ENABLED=n
CONFIG_BT_SPP_ENABLED=n

#
# ESP32-specific
#
CONFIG_ESP32_DEFAULT_CPU_FREQ_240=y
CONFIG_SPIRAM_SUPPORT=n
CONFIG_BROWNOUT_DET=

#
# SPI RAM config
#
CONFIG_SPIRAM_ALLOW_BSS_SEG_EXTERNAL_MEMORY=n

#
# Common ESP-related
#
CONFIG_MAIN_TASK_STACK_SIZE=2500
CONFIG_ESP32_DEBUG_STUBS_ENABLE=y
CONFIG_INT_WDT_TIMEOUT_MS=5000

#
# FAT Filesystem support
#
CONFIG_FATFS_LFN_HEAP=y
CONFIG_FATFS_FS_LOCK=10

#
# FreeRTOS
#
CONFIG_FREERTOS_HZ=1000
CONFIG_FREERTOS_USE_TRACE_FACILITY=y
CONFIG_FREERTOS_USE_STATS_FORMATTING_FUNCTIONS=y
```
